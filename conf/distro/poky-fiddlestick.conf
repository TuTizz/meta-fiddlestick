## conf/distro/poky-fiddlestick.conf
```bitbake
# Distribution definition for: poky-fiddlestick

# Switch to systemd
DISTRO_FEATURES_append = " systemd"
VIRTUAL-RUNTIME_init_manager = "systemd"
VIRTUAL-RUNTIME_initscripts = ""
VIRTUAL-RUNTIME_syslog = ""
VIRTUAL-RUNTIME_login_manager = "shadow-base"
DISTRO_FEATURES_BACKFILL_CONSIDERED = "sysvinit"
PACKAGECONFIG_append_pn-systemd = " resolved networkd iptc"


# Security flags
require conf/distro/poky.conf

DISTRO = "poky-fiddlestick"
DISTROOVERRIDES = "poky"

DISTRO_NAME = "Poky Bridge Firewall"
DISTRO_VERSION = "1.0"
#DISTRO_CODENAME = "Guacamole"
#SDK_VENDOR = "-mydistro-sdk"
#SDK_VERSION="${DISTRO_VERSION}"
#MAINTAINER = "info@mydistro.com"
#TARGET_VENDOR = "-poky-fiddlestick" # remove this. This generates : hecking target system type... Invalid configuration `aarch64-poky-fiddlestick-linux': system `bfiddlestickridge-linux' not recognized
#| configure: error: /bin/sh ../config.sub aarch64-poky-fiddlestick-linux failed

IMAGE_FSTYPES_raspberrypi3-64 = "rpi-sdimg"
# ENABLE UART
ENABLE_UART_raspberrypi3-64 = "1" 
# Avoid to have debug-tweaks set in EXTRA_IMAGE_FEATURE duue to default line in local.conf =>  EXTRA_IMAGE_FEATURES ?= "debug-tweaks"
EXTRA_IMAGE_FEATURES=""

MENDER_ARTIFACT_NAME = "release-1"

INHERIT += "mender-full"
#MENDER_FEATURES_ENABLE_append_aarch64 = " mender-image-sd mender-uboot"

ARTIFACTIMG_FSTYPE = "ext4"

#INHERIT += "cve-check"
```

## conf/layer.conf
```bitbake
# We have a conf and classes directory, add to BBPATH
BBPATH .= ":${LAYERDIR}"

# We have recipes-* directories, add to BBFILES
BBFILES += "${LAYERDIR}/recipes-*/*/*.bb \
            ${LAYERDIR}/recipes-*/*/*.bbappend"

BBFILE_COLLECTIONS += "meta-fiddlestick"
BBFILE_PATTERN_meta-fiddlestick = "^${LAYERDIR}/"
BBFILE_PRIORITY_meta-fiddlestick = "6"

LAYERDEPENDS_meta-fiddlestick = "core openembedded-layer meta-python networking-layer"
LAYERSERIES_COMPAT_meta-fiddlestick = "warrior zeus"
COMPATIBLE_MACHINE="^raspberrypi*"
```
